/*
 * DA2C_Int_CTC.c
 *
 * Created: 3/13/2019 9:38:47 PM
 * Author : Cody Hudson
 */ 

#define F_CPU 16000000UL
#include <avr/io.h>
#include <util/delay.h>
#include <avr/interrupt.h>

int Count = 0;				//SETS GLOBAL VARIABLE COUNT TO 0

int main(void)
{
	DDRB |= (1<<DDB2);		//SETS DIRECTION OF PORT B2 AS OUTPUT
	PORTB |= (1<<PORTB2);	//TURNS ON PULL UP RESISTOR OF PORT B2
	DDRD &= (0<<DDD2);		//SETS DIRECITON OF PORT D2 AS INPUT
	PORTD |= (1<<PORTD2);	//TURNS ON PULL UP RESISTOR OR PORT D2
	
	EICRA = 0x00;			//SETS THE INTRUPT TO ACTIVATE ON LOW LEVEL
	EIMSK = (1<<INT0);		//SETS THE INTRUPT TO BE EXTERNAL INTERUPTS 0
	sei ();					//SETS GLOBAL INTRUPT
	
	while(1)
	Count = 0;				//WAITS HERE FOR INTRUPT
}
ISR (INT0_vect){			//EXTERNAL INTERUPT ON PIN D.2
	OCR0A = 0xC2;			//SETS THE HIGHEST VALUE OF THE TIMMER TO BE 194
	TIMSK0 |= (1<<OCIE0A);	//SETS INTRUPT TO ACTIVATE ON COMPARE OF OCR0A
	sei ();					//SETS GLOBAL INTRUPT
	TCCR0A |= (1<<WGM01);	//SETS TIMMER TO CTC MODE
	TCCR0B |= (1<<CS02) | (1<<CS00);	//SETS PRESCALLER TO 1024
	
	while (Count < 100);	//WAITS HERE UNTIL TIMMER INTERUPT IS COMPLETE
}
ISR (TIMER0_COMPA_vect){	//TIMMER COMPARE INTERUPT A
	while (Count < 100){	//CONINUES LOOP UNTIL COUNT = 100
		PORTB &= (0<<PORTB2);//TURNS LED ON
		if ((TIFR0 & 0x02) == 0x02){	//IF THE OCF0A FLAG IS SET HIGH DO THIS
			TIFR0 = 0X02;	//CLEAR FLAG
			Count++;		//INCRIMENT COUNT
		}
	}
	PORTB |= (1<<PORTB2);	//TURNS LED OFF
}



