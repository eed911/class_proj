/*
 * DA2C_C.c
 *
 * Created: 3/13/2019 9:22:00 PM
 * Author : Cody Hudson
 */ 

#define F_CPU 16000000UL
#include <avr/io.h>
#include <util/delay.h>
#include <avr/interrupt.h>


int main(void)
{
	DDRB |= (1<<DDB2);		//SETS DIRECTION OF PORT B2 AS OUTPUT
	PORTB |= (1<<PORTB2);	//TURNS ON PULL UP RESISTOR OF PORT B2
	DDRD &= (0<<DDD2);		//SETS DIRECITON OF PORT D2 AS INPUT
	PORTD |= (1<<PORTD2);	//TURNS ON PULL UP RESISTOR OR PORT D2
	
	EICRA = 0x00;			//SETS THE INTRUPT TO ACTIVATE ON LOW LEVEL
	EIMSK = (1<<INT0);		//SETS THE INTRUPT TO BE EXTERNAL INTERUPTS 0
	sei ();					//SETS GLOBAL INTRUPT
	
	while(1);				//WAITS HERE FOR INTRUPT
}
ISR (INT0_vect)				//EXTERNAL INTERUPT SUBROUTINE
{
	uint8_t Count = 0;		//SETS INTERGER VARIABLE COUNT TO 0
	TCCR0A = 0;				//SETS TIMMER TO NORMAL MODE
	TCCR0B |= (1<<CS02)|(1<<CS00);	//SETS PRESCALER TO 1024
	while (Count < 76){		//WHILE COUNT IS LESS THAN 76 LOOP
		PORTB &= (0<<PORTB2);//TURNS LED ON
		if ((TIFR0 & 0x01) == 1){ //IF BIT 1 IN FLAG IS SET HIGH DO THIS
			TIFR0 = 0X01;	//CLEAR FLAG REGISTER
			Count++;		//INCRIMENT COUNT
		}
	}
	
	PORTB |= (1<<PORTB2);	//TURNS LED OFF
}



