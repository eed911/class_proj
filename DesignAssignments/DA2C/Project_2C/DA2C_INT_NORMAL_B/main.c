/*
 * DA2C.c
 *
 * Created: 3/13/2019 8:59:41 PM
 * Author : Cody Hudson
 */ 
#define F_CPU 16000000UL
#include <avr/io.h>
#include <util/delay.h>
#include <avr/interrupt.h>

int Count = 0;
int main(void)
{
	DDRB |= (1<<DDB2);		//SETS DIRECTION OF PORT B2 AS OUTPUT
	PORTB |= (1<<PORTB2);	//TURNS ON PULL UP RESISTOR OF PORT B2
	DDRD &= (0<<DDD2);		//SETS DIRECITON OF PORT D2 AS INPUT
	PORTD |= (1<<PORTD2);	//TURNS ON PULL UP RESISTOR OR PORT D2
	
	EICRA = 0x00;			//SETS THE INTRUPT TO ACTIVATE ON LOW LEVEL
	EIMSK = (1<<INT0);		//SETS THE INTRUPT TO BE EXTERNAL INTERUPTS 0
	sei ();					//SETS GLOBAL INTRUPT
	
	while(1);				//WAITS HERE FOR INTRUPT
}
ISR (INT0_vect)				//EXTERNAL INTERRUPT ON PIN D.2
{
	TIMSK0 |= (1<<TOIE0);	//SETS THE INERRUPT TO ACTIVATE WHEN TIMMER 0 GETS OVERFLOW FLAG
	sei ();					//SETS GLOBAL INTERRUPT
	TCCR0A = 0x00;			//SETS NORMAL MODE ON TIMMER
	TCCR0B |= (1<<CS02)|(1<<CS00);	//SETS PRESCALER TO 1024
	while (1){				//WAIT HERE UNITL FURTHER NOTICE
		if (Count > 75){	//WHEN COUNT = 75 DO THIS
			Count = 0;		//SET COUNT TO 0
			break;			//EXIT WHILE LOOP
		}
	}
}

ISR (TIMER0_OVF_vect){		//TV0V FLAG INTERUPT
	while (Count < 76){		//WHILE COUNT IS LESS THAN 76 LOOP
		PORTB &= (0<<PORTB2);//TURNS LED ON
		if ((TIFR0 & 0x01) == 1){	//IF TV0V FLAG IS HIGH DO THIS
			TIFR0 = 0X01;	//CLEAR FLAG
			Count++;		//INCREMENT COUNT
		}
	}
	PORTB |= (1<<PORTB2);	//TURNS LED OFF
}