;
; DA2B_ASM.asm
;
; Created: 3/8/2019 7:55:29 PM
; Author : Cody Hudson
;

 .ORG 0
 RJMP START					;JMPS TO START
 .ORG 0x02
 RJMP EXO_ISR				;JMPS TO EXTERNAL INTRUPT SUBROUTINE

 START:
	 LDI R16, 0x04			;LOADS 0b00000100 IN R 16
	 OUT DDRB, R16			;SETS DIRECTION AS OUTPUT AT BIT 3
	 OUT PORTB, R16			;SETS PULL UP RESISTOR AT PIN 3 OF B
	 LDI R17, 0x00			;LOADS 0b00000000 INTO R17
	 OUT DDRD, R17			;SETS DIRECTION AS INPUT FOR ALL D
	 SBI PORTD, 2			;SETS PULL UP RESISTOR AT PIN 2 OF D
	 NOP

 ;Initialize Interrupt
	LDI R20, 0x2			;CONFIGURE INTERRUPT TO OCCUR INT0 FOR FALLING EDGE TRIGGER
	STS EICRA, R20			;LOAD CONFIGURE INTO REGISTER
	LDI R20, 1<< INT0		;ENABLE EXTERNAL INTERRUPT INT0(PD2)
	OUT EIMSK, R20			;LOAD ENABLE INTO REGISTER
	SEI						;GLOBAL INTERRUPT ENABLE COMMAND

HERE: JMP HERE


EXO_ISR:
	LDI R21, 0xFB			;LOADS 0b11111011 ONTO R21
	OUT PORTB, R21			;TURNS ON LED
	RCALL DELAY_1S			;RUN THROUGH DELAYS
	RCALL DELAY_100MS
	RCALL DELAY_100MS
	RCALL DELAY_50MS
	OUT PORTB, R16			;TURN OFF LED
	RETI
	
	//SAME DELAY SUBROUTINE FROM BEFOR
	DELAY_1S:
	RCALL DELAY_100MS
	RCALL DELAY_100MS
	RCALL DELAY_100MS
	RCALL DELAY_100MS
	RCALL DELAY_100MS
	RCALL DELAY_100MS
	RCALL DELAY_100MS
	RCALL DELAY_100MS
	RCALL DELAY_100MS
	RCALL DELAY_100MS
	RET

DELAY_100MS:
	RCALL DELAY_50MS
	RCALL DELAY_50MS
	RET

DELAY_50MS:
	RCALL DELAY_10MS
	RCALL DELAY_10MS
	RCALL DELAY_10MS
	RCALL DELAY_10MS
	RCALL DELAY_10MS
	RET

DELAY_10MS:
	RCALL DELAY_5MS
	RCALL DELAY_5MS
	RET

DELAY_5MS:
	RCALL DELAY_1MS
	RCALL DELAY_1MS
	RCALL DELAY_1MS
	RCALL DELAY_1MS
	RCALL DELAY_1MS
	RET

DELAY_1MS:
	PUSH R16
	PUSH R18
	LDI R16,255
	LDI R18, 6
	DELAY_1A:
		DELAY1_B:
			NOP
			NOP
			NOP
			NOP
			NOP
			NOP
			NOP
			NOP
			DEC R16
			BRNE DELAY1_B
		DEC R18
		BRNE DELAY1_B
		POP R18
		POP R16
		RET
	