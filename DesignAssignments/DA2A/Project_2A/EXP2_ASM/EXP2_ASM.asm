/*
 * EXP2_ASM.asm
 *
 *  Created: 3/2/2019 10:59:01 AM
 *   Author: hudsoc1
 */ 


 .ORG 0
 LDI R16, 0x04			;LOADS 0b00000100 IN R 16
 OUT DDRB, R16			;SETS DIRECTION AS OUTPUT AT BIT 3
 OUT PORTB, R16			;SETS PULL UP RESISTOR AT PIN 3 OF B
 LDI R17, 0x00			;LOADS 0b00000000 INTO R17
 OUT DDRC, R17			;SETS DIRECTION AS INPUT FOR ALL C
 OUT PORTC, R16			;SETS PULL UP RESISTOR AT PIN 3 OF C
 NOP

 MAIN:
	IN R20, PINC		;READS INPUT FROM PIN C SETS TO R20
	COM R20				;TAKE 1 COMPLEIMENT OF R20
	ANDI R20, 0x04 		;ANDS THE COMPLIMENT OF THE INPUT WITH 0b00000100
	CPI R20, 0x04		;COMPARES R20 WITH 0b00000100 IF TRUE MOVE ON
	BRNE MAIN			; IF NOT TURE REPEAT UNTIL TRUE

LIGHT_ON:
	LDI R21, 0xFB		;LOADS 0b11111011 ONTO R21
	OUT PORTB, R21		;TURNS ON LED
	RCALL DELAY_1250MS

	OUT PORTB, R16		;TURN OFF LED
	RJMP MAIN			;REPEAT 

	//CREATED FUNCITON FOR A DELAY OF 1.25s
	//USES 1x DELAY_1s, 2xDELAY_100ms, 1x DELAY_50ms	
DELAY_1250MS:
	RCALL DELAY_1S		
	RCALL DELAY_100MS
	RCALL DELAY_100MS
	RCALL DELAY_50MS
	RET

	//CREATED FUNCITON FOR A DELAY OF 1s
	//USES 10x DELAY 100Ms
DELAY_1S:
	RCALL DELAY_100MS
	RCALL DELAY_100MS
	RCALL DELAY_100MS
	RCALL DELAY_100MS
	RCALL DELAY_100MS
	RCALL DELAY_100MS
	RCALL DELAY_100MS
	RCALL DELAY_100MS
	RCALL DELAY_100MS
	RCALL DELAY_100MS
	RET

	//CREATED FUNCITON FOR A DELAY OF 100ms
	//USES 2x DELAY 50ms
DELAY_100MS:
	RCALL DELAY_50MS
	RCALL DELAY_50MS
	RET

	//CREATED FUNCITON FOR A DELAY OF 100ms
	//USES 5x DELAY 10ms
DELAY_50MS:
	RCALL DELAY_10MS
	RCALL DELAY_10MS
	RCALL DELAY_10MS
	RCALL DELAY_10MS
	RCALL DELAY_10MS
	RET

	//CREATED FUNCITON FOR A DELAY OF 100ms
	//USES 2x DELAY 5ms
DELAY_10MS:
	RCALL DELAY_5MS
	RCALL DELAY_5MS
	RET

	//CREATED FUNCITON FOR A DELAY OF 100ms
	//USES 5x DELAY 1ms
DELAY_5MS:
	RCALL DELAY_1MS
	RCALL DELAY_1MS
	RCALL DELAY_1MS
	RCALL DELAY_1MS
	RCALL DELAY_1MS
	RET

	//CREATED FUNCITON FOR A DELAY OF 1ms
DELAY_1MS:
	PUSH R16				;PUSHES VALUE OF R16 ONTO STACK
	PUSH R18				;PUSHES VALUE OF R18 ONTO STACK
	LDI R16,255				;LOADS A VALUE OF 255 INTO R16
	LDI R18, 6				;LOADS A VALUE OF 6 INTO R18
	DELAY_1A:
		DELAY1_B:
			NOP				;SEQUECE OF DOING NOTHING TO TAKE UP 8 CLOCK CYCLES
			NOP
			NOP
			NOP
			NOP
			NOP
			NOP
			NOP
			DEC R16			;DECREMENT R16 255 TIMES
			BRNE DELAY1_B	;REPEAT THIS LOOP UNTIL R16 = 0
		DEC R18				;DECREENT R18 6 TIMES
		BRNE DELAY1_B		;REPEAT THIS LOOP UNTIL R18 = 0
		POP R18				;POP VALUE OF R18 OUT OF STACK
		POP R16				;POP VALUE OF R16 OUT OF STACK
		RET					;RETURN TO THE WHEN WAS CALLED